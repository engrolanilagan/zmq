## hello/Kconfig
```kconfig
#
# For a description of the syntax of this configuration file,
# see the file kconfig-language.txt in the NuttX tools repository.
#

config ZMQ_HELLO
	tristate "\"Hello ZMQ!\" example"
	default n
	---help---
		Enable the \"Hello ZMQ!\" example

if ZMQ_HELLO
endif
```

## hwclient/Kconfig
```kconfig
#
# For a description of the syntax of this configuration file,
# see the file kconfig-language.txt in the NuttX tools repository.
#

config ZMQ_HWCLIENT
	tristate "\"ZMQ HelloWorld Client\" example"
	default n
	---help---
		Enable the ZMQ TCP Client example

if ZMQ_HWCLIENT
endif
```

## hwserver/Kconfig
```kconfig
#
# For a description of the syntax of this configuration file,
# see the file kconfig-language.txt in the NuttX tools repository.
#

config ZMQ_HWSERVER
	tristate "\"ZMQ HelloWorld Server\" example"
	default n
	---help---
		Enable the ZMQ TCP Server example

if ZMQ_HWSERVER
endif
```
